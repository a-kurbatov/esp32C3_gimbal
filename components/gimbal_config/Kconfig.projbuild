## components/gimbal_config/Kconfig.projbuild
```kconfig
menu "Gimbal Project"

config GIMBAL_LOOP_HZ
    int "Control loop frequency (Hz)"
    default 10

config GIMBAL_ALPHA
    int "Complementary filter alpha x1000 (0..1000)"
    range 0 1000
    default 980

config GIMBAL_PID_KP
    int "PID Kp x1000"
    default 1200

config GIMBAL_PID_KI
    int "PID Ki x1000"
    default 0

config GIMBAL_PID_KD
    int "PID Kd x1000"
    default 50

config GIMBAL_ANTENNA_LIMIT_DEG
    int "Antenna angle limit +/- (deg)"
    default 32

config GIMBAL_SERVO_LIMIT_DEG
    int "Servo angle limit +/- (deg)"
    default 105

config GIMBAL_MECH_RATIO
    int "Mechanical ratio x1000 (servo/antenna)"
    default 3280

comment "IMU selection"

choice GIMBAL_IMU_SELECT
    prompt "IMU driver"
    default GIMBAL_IMU_SELECT_EMULATOR
    help
        Select the IMU used. Keep code switchable.

config GIMBAL_IMU_SELECT_EMULATOR
    bool "Emulator (no hardware)"

config GIMBAL_IMU_SELECT_ICM42688P
    bool "ICM-42688-P"

config GIMBAL_IMU_SELECT_BNO08X
    bool "BNO08X (BNO080/085)"

config GIMBAL_IMU_SELECT_MSP_2AXIS
    bool "MSP IMU (2-axis via FC)"
    help
        Use MSP (MultiWii Serial Protocol) from a flight controller (e.g., Betaflight 4.4.2+)
        at 115200 baud to obtain yaw/pitch data. This mode targets 2-axis control
        (yaw + pitch) and disables SPI IMU usage.

endchoice

config GIMBAL_ICM_USE_SPI
    bool "Use SPI for ICM-42688-P"
    default y
    depends on GIMBAL_IMU_SELECT_ICM42688P

config GIMBAL_ICM_USE_I2C
    bool "Use I2C for ICM-42688-P"
    default n
    depends on GIMBAL_IMU_SELECT_ICM42688P

config GIMBAL_SPI_SCLK_GPIO
    int "SPI SCLK GPIO"
    default 4
    depends on (GIMBAL_IMU_SELECT_ICM42688P && GIMBAL_ICM_USE_SPI) || (GIMBAL_IMU_SELECT_BNO08X && GIMBAL_BNO08X_USE_SPI)

config GIMBAL_SPI_MOSI_GPIO
    int "SPI MOSI GPIO"
    default 6
    depends on (GIMBAL_IMU_SELECT_ICM42688P && GIMBAL_ICM_USE_SPI) || (GIMBAL_IMU_SELECT_BNO08X && GIMBAL_BNO08X_USE_SPI)

config GIMBAL_SPI_MISO_GPIO
    int "SPI MISO GPIO"
    default 5
    depends on (GIMBAL_IMU_SELECT_ICM42688P && GIMBAL_ICM_USE_SPI) || (GIMBAL_IMU_SELECT_BNO08X && GIMBAL_BNO08X_USE_SPI)

config GIMBAL_SPI_CS_GPIO
    int "SPI CS GPIO"
    default 7
    depends on (GIMBAL_IMU_SELECT_ICM42688P && GIMBAL_ICM_USE_SPI) || (GIMBAL_IMU_SELECT_BNO08X && GIMBAL_BNO08X_USE_SPI)

config GIMBAL_BNO08X_SPI_MODE
    int "BNO08x SPI mode (0..3)"
    depends on GIMBAL_IMU_SELECT_BNO08X && GIMBAL_BNO08X_USE_SPI
    range 0 3
    default 0

config GIMBAL_I2C_SDA_GPIO
    int "I2C SDA GPIO"
    default 7
    depends on (GIMBAL_IMU_SELECT_ICM42688P && GIMBAL_ICM_USE_I2C) || (GIMBAL_IMU_SELECT_BNO08X && GIMBAL_BNO08X_USE_I2C)

config GIMBAL_I2C_SCL_GPIO
    int "I2C SCL GPIO"
    default 3
    depends on (GIMBAL_IMU_SELECT_ICM42688P && GIMBAL_ICM_USE_I2C) || (GIMBAL_IMU_SELECT_BNO08X && GIMBAL_BNO08X_USE_I2C)

config GIMBAL_I2C_FREQ_HZ
    int "I2C clock (Hz)"
    default 400000
    depends on (GIMBAL_IMU_SELECT_ICM42688P && GIMBAL_ICM_USE_I2C) || (GIMBAL_IMU_SELECT_BNO08X && GIMBAL_BNO08X_USE_I2C)

config GIMBAL_BNO08X_ADDR
    hex "BNO08x I2C address"
    default 0x4A
    depends on GIMBAL_IMU_SELECT_BNO08X && GIMBAL_BNO08X_USE_I2C

config GIMBAL_BNO08X_INT_GPIO
    int "BNO08x INT GPIO (-1 to disable)"
    depends on GIMBAL_IMU_SELECT_BNO08X
    default -1

config GIMBAL_BNO08X_INT_ACTIVE_LOW
    bool "BNO08x INT is active-low"
    depends on GIMBAL_IMU_SELECT_BNO08X
    default y

config GIMBAL_BNO08X_SPI_TRACE
    bool "Enable BNO08x SPI trace (first packets)"
    depends on GIMBAL_IMU_SELECT_BNO08X && GIMBAL_BNO08X_USE_SPI
    default n

config GIMBAL_BNO08X_WAKE_GPIO
    int "BNO08x WAKE GPIO (-1 to disable)"
    depends on GIMBAL_IMU_SELECT_BNO08X
    default -1

config GIMBAL_BNO08X_RST_GPIO
    int "BNO08x RESET GPIO (-1 to disable)"
    depends on GIMBAL_IMU_SELECT_BNO08X
    default -1

choice GIMBAL_BNO08X_TRANSPORT
    prompt "BNO08x transport"
    depends on GIMBAL_IMU_SELECT_BNO08X
    default GIMBAL_BNO08X_USE_SPI

config GIMBAL_BNO08X_USE_I2C
    bool "I2C"

config GIMBAL_BNO08X_USE_SPI
    bool "SPI"

endchoice

config GIMBAL_SERVO_GPIO
    int "Servo PWM GPIO"
    default 10

config GIMBAL_SERVO_FREQ_HZ
    int "Servo PWM frequency (Hz)"
    default 50

config GIMBAL_SERVO_MIN_US
    int "Servo min pulse (us)"
    default 500

config GIMBAL_SERVO_MAX_US
    int "Servo max pulse (us)"
    default 2500

config GIMBAL_BUTTON_GPIO
    int "Calibration button GPIO (active-low)"
    default 1

config GIMBAL_BUTTON_LONG_MS
    int "Long-press duration (ms)"
    default 2000

comment "UART-RVC sniffer (BNO08x transport sanity test)"

config GIMBAL_UART_RVC_SNIFFER
    bool "Enable UART-RVC sniffer task (disables IMU/SPI)"
    default n
    help
        When enabled, the app will not initialize the IMU or SPI pins.
        Instead, it starts a small UART reader that logs incoming bytes
        from the BNO08x when strapped to UART-RVC mode (PS1=HIGH, PS0=LOW).

config GIMBAL_UART_PORT
    int "UART port for RVC sniffer"
    default 1
    depends on GIMBAL_UART_RVC_SNIFFER

config GIMBAL_UART_RX_GPIO
    int "UART RX GPIO (ESP32-C3 pin wired to BNO TX)"
    default 5
    depends on GIMBAL_UART_RVC_SNIFFER

config GIMBAL_UART_TX_GPIO
    int "UART TX GPIO (-1 to disable)"
    default -1
    depends on GIMBAL_UART_RVC_SNIFFER

config GIMBAL_UART_BAUD
    int "UART baud rate"
    default 115200
    depends on GIMBAL_UART_RVC_SNIFFER

endmenu

menu "MSP (2-axis) Settings"
    depends on GIMBAL_IMU_SELECT_MSP_2AXIS

config GIMBAL_MSP_UART_PORT
    int "MSP UART port"
    default 1

config GIMBAL_MSP_UART_RX_GPIO
    int "MSP UART RX GPIO (FC TX to ESP32 RX)"
    default 5

config GIMBAL_MSP_UART_TX_GPIO
    int "MSP UART TX GPIO (ESP32 TX to FC RX)"
    default 6

config GIMBAL_MSP_UART_BAUD
    int "MSP UART baud rate"
    default 115200

config GIMBAL_SERVO_YAW_GPIO
    int "Yaw Servo PWM GPIO"
    default 8

config GIMBAL_MSP_DEBUG_RX
    bool "Verbose MSP RX sniff logs (debug)"
    help
        When enabled, logs raw bytes received on the MSP UART to aid bring-up.
        Disable for normal operation to reduce log noise.
    default n

comment "TODO: Add per-axis mechanics and ranges (min/max us, ratio, limits)"

endmenu

menu "Yaw servo mapping (servo-centric)"
    depends on GIMBAL_IMU_SELECT_MSP_2AXIS

config GIMBAL_YAW_SERVO_MAX_DEG
    int "Yaw servo total travel (deg)"
    help
        Total servo travel used for yaw axis mapping. Half-swing is half of this value.
    range 60 360
    default 180

config GIMBAL_YAW_SERVO_ALLOWED_DEG
    int "Yaw servo allowed travel (deg)"
    help
        Restrict the commanded yaw servo travel to protect mechanics. For example, if the servo is
        capable of 270°, set this to 250° to keep 10° margin on both ends. Controller will never
        command outside ±(allowed/2).
    range 10 360
    default 180

config GIMBAL_YAW_RATIO_SERVO_PER_ANT_X1000
    int "Yaw gearing: servo deg per antenna deg x1000"
    help
        Set to 333 for 1:3 gearing (0.333 servo deg per antenna deg). Higher values mean more servo
        movement per antenna degree.
    range 1 10000
    default 333

config GIMBAL_ANTENNA_OPENING_DEG
    int "Antenna horizontal opening (deg)"
    help
        Horizontal 3 dB beamwidth (approx). Controller will not rotate when the error is inside half of this value.
    range 0 120
    default 10

endmenu
```

## sdkconfig.defaults
```kconfig
# Defaults for this project (ESP-IDF 5.5.x)

# Target (default board)
CONFIG_IDF_TARGET_ESP32-C3=y

# Gimbal project options
#CONFIG_GIMBAL_IMU_SELECT_EMULATOR=y
#CONFIG_GIMBAL_IMU_SELECT_ICM42688P=y
CONFIG_GIMBAL_IMU_SELECT_BNO08X=y
#CONFIG_GIMBAL_IMU_SELECT_MSP_2AXIS=y
# Switch BNO08x transport to SPI (mode 3)
CONFIG_GIMBAL_BNO08X_USE_SPI=y
# CONFIG_GIMBAL_BNO08X_USE_I2C is not set

# Bus selection for ICM-42688-P (SPI by default)
CONFIG_GIMBAL_ICM_USE_SPI=y
#CONFIG_GIMBAL_ICM_USE_I2C=n

# SPI pins (ESP32-C3 remap to match board wiring)
CONFIG_GIMBAL_SPI_SCLK_GPIO=4
CONFIG_GIMBAL_SPI_MOSI_GPIO=6
CONFIG_GIMBAL_SPI_MISO_GPIO=5
CONFIG_GIMBAL_SPI_CS_GPIO=7
# Use SPI mode 0 by default for BNO08x
CONFIG_GIMBAL_BNO08X_SPI_MODE=3
# CONFIG_GIMBAL_BNO08X_SPI_TRACE is not set

# SPI pins (ESP32-C3 remap to match board wiring)
CONFIG_GIMBAL_SPI_SCLK_GPIO=4
CONFIG_GIMBAL_SPI_MOSI_GPIO=6
CONFIG_GIMBAL_SPI_MISO_GPIO=5
CONFIG_GIMBAL_SPI_CS_GPIO=7
CONFIG_GIMBAL_BNO08X_SPI_MODE=3

# INT/RESET/WAKE
CONFIG_GIMBAL_BNO08X_INT_GPIO=9
CONFIG_GIMBAL_BNO08X_INT_ACTIVE_LOW=y
CONFIG_GIMBAL_BNO08X_WAKE_GPIO=3
CONFIG_GIMBAL_BNO08X_RST_GPIO=2

# Servo (LEDC)
CONFIG_GIMBAL_SERVO_GPIO=10
# Yaw servo for 2-axis MSP mode
CONFIG_GIMBAL_SERVO_YAW_GPIO=8
CONFIG_GIMBAL_SERVO_FREQ_HZ=50
CONFIG_GIMBAL_SERVO_MIN_US=500
CONFIG_GIMBAL_SERVO_MAX_US=2500

# Button (active-low with internal pull-up)
CONFIG_GIMBAL_BUTTON_GPIO=1
CONFIG_GIMBAL_BUTTON_LONG_MS=2000

# Control
CONFIG_GIMBAL_LOOP_HZ=100
# Scaled by 1000
CONFIG_GIMBAL_ALPHA=950
CONFIG_GIMBAL_PID_KP=6000
CONFIG_GIMBAL_PID_KI=0
CONFIG_GIMBAL_PID_KD=100

# Mechanics (hard-coded defaults for now)
CONFIG_GIMBAL_ANTENNA_LIMIT_DEG=32
CONFIG_GIMBAL_SERVO_LIMIT_DEG=105
CONFIG_GIMBAL_MECH_RATIO=3280

# UART-RVC sniffer (enable to test BNO08x UART stream; disables IMU/SPI init)
# CONFIG_GIMBAL_UART_RVC_SNIFFER is not set
CONFIG_GIMBAL_UART_PORT=1
# ESP32-C3 RX pin wired to BNO085 TX pin (module pin often labeled GPIO6)
CONFIG_GIMBAL_UART_RX_GPIO=6
CONFIG_GIMBAL_UART_TX_GPIO=-1
CONFIG_GIMBAL_UART_BAUD=115200

# MSP (2-axis) defaults (active only when MSP mode is selected)
CONFIG_GIMBAL_MSP_UART_PORT=1
CONFIG_GIMBAL_MSP_UART_RX_GPIO=5
CONFIG_GIMBAL_MSP_UART_TX_GPIO=6
CONFIG_GIMBAL_MSP_UART_BAUD=115200
```
